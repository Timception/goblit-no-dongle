## boards/shields/goblit/Kconfig.shield
```kconfig
config SHIELD_GOBLIT_LEFT
    def_bool $(shields_list_contains,goblit_left)

config SHIELD_GOBLIT_RIGHT_CENTRAL
    def_bool $(shields_list_contains,goblit_right_central)
```
